## CMakeLists.txt
```
# SPDX-License-Identifier: Apache-2.0

cmake_minimum_required(VERSION 3.13.1)
find_package(Zephyr REQUIRED HINTS $ENV{ZEPHYR_BASE})
project(scan_adv)

FILE(GLOB app_sources src/*.c*)
target_sources(app PRIVATE ${app_sources})
set(CMAKE_VERBOSE_MAKEFILE ON CACHE BOOL "ON")
zephyr_library_include_directories(${ZEPHYR_BASE}/samples/bluetooth)
```

## prj.conf
```kconfig
CONFIG_BT=y
CONFIG_SOC_SERIES_NRF52X=y
CONFIG_BT_BROADCASTER=y
CONFIG_BT_OBSERVER=y
CONFIG_BT_HCI=y
#CONFIG_BOARD_NRF52840DONGLE_NRF52840=y
#CONFIG_BOARD_NRF52840DK_NRF52840=y
CONFIG_BT_CTLR_TX_PWR_PLUS_8=y
#CONFIG_BLE_GAP_PHY_CODED=y
#CONFIG_BT_CTLR_TX_PWR_MINUS_40=y

# Link Layer
#NRF
#CONFIG_SOFTDEVICE_CONTROLLER_S140=y
#CONFIG_BT_LL_SOFTDEVICE=y
#CONFIG_BT_LL_NRFXLIB_VS_INCLUDE=y
#CONFIG_BT_LL_NRFXLIB_DEFAULT=y
CONFIG_BT_EXT_ADV=y
CONFIG_BT_CTLR_PHY_CODED=y
CONFIG_BT_PHY_UPDATE=y

CONFIG_GPIO=y
CONFIG_SENSOR=y

##enable this for dongle
#DONGLE START
CONFIG_USB=y
CONFIG_USB_DEVICE_STACK=y
CONFIG_USB_DEVICE_PRODUCT="BluPulse V0.1"
CONFIG_USB_UART_CONSOLE=y
#
CONFIG_UART_INTERRUPT_DRIVEN=y
CONFIG_UART_LINE_CTRL=y
CONFIG_UART_CONSOLE_ON_DEV_NAME="CDC_ACM_0"
#DONGLE_END

CONFIG_SERIAL=y

#-----------
CONFIG_BT_DEVICE_NAME="AdvX"
CONFIG_BT_PERIPHERAL=y
CONFIG_BT_OBSERVER=y
CONFIG_BT_CENTRAL=y
CONFIG_BT_PER_ADV=y
CONFIG_BT_PER_ADV_SYNC=y

CONFIG_BT_CTLR_ADV_EXT=y
CONFIG_BT_CTLR_ADV_PERIODIC=y
CONFIG_BT_CTLR_SYNC_PERIODIC=y

#CONFIG_I2C_NRFX=y
#CONFIG_I2C_0=y

# C++
CONFIG_CPLUSPLUS=y
CONFIG_NEWLIB_LIBC=y
CONFIG_LIB_CPLUSPLUS=y

#I2C
CONFIG_I2C=y
CONFIG_I2C_NRFX=y

#ADC
CONFIG_ADC=y


#PM
#CONFIG_SYS_POWER_MANAGEMENT=y
#CONFIG_SYS_POWER_DEEP_SLEEP_STATES=n
#CONFIG_SYS_POWER_SLEEP_STATES=n
# Required to disable default behavior of deep sleep on timeout
#CONFIG_SYS_PM_STATE_LOCK=y
#CONFIG_DEVICE_POWER_MANAGEMENT=y
#CONFIG_GPIO=y

#system ticks
CONFIG_SYS_CLOCK_EXISTS=y
CONFIG_SYS_CLOCK_TICKS_PER_SEC=125

##Auto Suspend
#CONFIG_DEVICE_IDLE_PM=y
#
#CONFIG_SYS_POWER_DEEP_SLEEP_STATES=y
##
CONFIG_TICKLESS_KERNEL=y
CONFIG_SYS_POWER_MANAGEMENT=y
CONFIG_DEVICE_POWER_MANAGEMENT=y

#Threading
CONFIG_HEAP_MEM_POOL_SIZE=256


###########Timer
#CONFIG_COUNTER=y
#CONFIG_COUNTER_TIMER1=y
#CONFIG_COUNTER_TIMER2=y
#CONFIG_COUNTER_TIMER3=y
#CONFIG_COUNTER_TIMER4=y



#Watch Dog
CONFIG_WATCHDOG=y
```

## src/main.cpp
```c
/* main.c - Application main entry point */

/*
 * Copyright (c) 2015-2016 Intel Corporation
 *
 * SPDX-License-Identifier: Apache-2.0
 */
//https://jimmywongiot.com/2019/12/18/step-by-step-on-nordic-connect-sdk-for-development/
#include <zephyr/types.h>
#include <stddef.h>

#include <sys/util.h>
#include <stdio.h>
#include <stdlib.h>

#include <zephyr.h>
#include <device.h>
#include <devicetree.h>
#include <drivers/gpio.h>
#include <usb/usb_device.h>
#include <drivers/uart.h>
#include <logging/log.h>
#include <math.h>

#include "kernel.h"
#include "Q_GPIO.hpp"
#include "Q_Bluetooth.hpp"
#include "Q_Logger.h"
#include "Q_Timer.hpp"
#include "Q_ULP.hpp"
#include "Q_adc.hpp"
#include "Q_Globals.hpp"
// ------------CONFIGURATION---------------
#define USB_UART

#ifdef CONFIG_USB
#endif
#define LED_INIT

//#define Q_I2C

#if  defined BLE5_ADV || defined BLE4_ADV || defined BLE5_SCANNER || defined BLE4_SCANNER
#endif


#ifdef Q_ADC
#include "Q_adc.hpp"
int adc_1 = -1;
int adc_2 = -1;
#endif





#ifdef Q_I2C

//#if DT_NODE_HAS_STATUS(DT_ALIAS(i2c_0), okay)
//#define I2C_DEV_NAME DT_LABEL(DT_ALIAS(i2c_0))
//#elif DT_NODE_HAS_STATUS(DT_ALIAS(i2c_1), okay)
//#define I2C_DEV_NAME DT_LABEL(DT_ALIAS(i2c_1))
//#elif DT_NODE_HAS_STATUS(DT_ALIAS(i2c_2), okay)
//#define I2C_DEV_NAME DT_LABEL(DT_ALIAS(i2c_2))
//#else
//#error "Please set the correct I2C device"
//#endif
const struct device *i2c_dev;

#include <drivers/i2c.h>

#endif
#ifdef USB_UART
const struct device *devUART;
uint32_t dtr = 0U;
#endif

int ret;
int i = 0;

const struct device *dev0;
const struct device *dev1;

bool q_led_rcv_is_on = false;
bool q_led_snd_is_on = true;



#ifdef Q_GPIO_INIT

void init_gpio()
{
#ifdef Q_GPIO_INIT
	printq("Init Pins\n");
	q_led_1.init(LED1);
	printq("Led 1 Ok\n");
	q_led_0.init(LED0);
	printq("Led 0 Ok\n");
#endif
}

#endif

void init_led()
{
#ifdef LED_INIT

	dev0 = device_get_binding(LED0);
	dev1 = device_get_binding(LED1);
	if (dev0 == NULL) {
		printq("failed init LED0");
		return;
	}
	if (dev1 == NULL) {
		printq("failed init LED1");
		return;
	}

	ret = gpio_pin_configure(dev0, PIN0, GPIO_OUTPUT_ACTIVE | FLAGS0);
	if (ret < 0) {
		printq("failed init PIN0");
		return;
	}

	ret = gpio_pin_configure(dev1, PIN1, GPIO_OUTPUT_ACTIVE | FLAGS1);
	if (ret < 0) {
		printq("failed init PIN1");

		return;
	}
	gpio_pin_set(dev1, PIN1, (int) q_led_rcv_is_on);
	gpio_pin_set(dev0, PIN0, (int) q_led_snd_is_on);
#endif 
}

void init_i2c()
{
#ifdef Q_I2C
	i2c_dev = device_get_binding(I2C_DEV);
	if (!i2c_dev) {
		printq("I2C: Device driver not found.\n");
		return;
	}
#endif
}

#ifdef Q_I2C

#endif

void init_usb_uart()
{
#ifdef USB_UART
	devUART = device_get_binding("CDC_ACM_0");
	if (!devUART) {
		printq("CDC ACM device not found");
		return;
	}
	printq("CDC ACM Ready.");
	//
	ret = usb_enable(NULL);
	if (ret != 0) {
		printq("Failed to enable USB");

		return;
	}
	printq("Usb Enabled.");
#endif
}

void init_system()
{
	//--------------------- USB_UART ---------------------

	init_usb_uart();

	//--------------------- GPIO  ---------------------
#ifdef Q_GPIO_INIT
	init_gpio();
#endif

	//    --------------------- LEDS | GPIO---------------------
	init_led();

	//--------------------- Bluetooth Subsystem ---------------------
	init_bluetooth();

	//--------------------- Bluetooth 4 Scanner---------------------
	ble4_scanner();

	//--------------------- Bluetooth 5 Scanner---------------------


	//--------------------- Bluetooth 4 Advertising---------------------
	ble4_adv();

	//--------------------- Bluetooth 5 Advertising---------------------

	//---------------------           I2C          ---------------------
	init_i2c();


#ifdef Q_ADC
	//---------------------           ADC          ---------------------
	init_adc();
	init_adc_pin_1();
	init_adc_pin_2();
#endif
}

void readAdc()
{
#ifdef Q_ADC
	printq("reading ADC1\n");

	adc_1 = read_adc_1();
	printq("ADC1 ==%d\n", adc_1);
	adc_2 = read_adc_2();
	printq("ADC2 =%d\n", adc_2);
#endif
}

void main_thread()
{
	while (!ready) {
		k_sleep(K_SECONDS(1));
	}
	printq("mainThread started..\n");

	do {
		//	    printq("sleeping for %d\n",k_uptime_get_32());
		k_sleep(K_MSEC(500));
#ifdef Q_ADC
		readAdc();
#endif

#if  defined BLE5_ADV || defined BLE4_ADV
#endif
	} while (1);
}

void thread_ble()
{
	while (!ready) {
		k_sleep(K_SECONDS(1));
	}
	printq("thread_blue started..\n");
	start_ble5_scanner();
	while (1) {
		k_sleep(K_SECONDS(1));
	}
}

void main(void)
{

	init_system();
	ready = true;

	//Enter main thread in sleep
	k_cpu_idle();

}
//
//K_THREAD_DEFINE(main_thread_id, 1024, main_thread, NULL, NULL, NULL,
//	7, 0, 0);

K_THREAD_DEFINE(thread_ble_id, 1024, thread_ble, NULL, NULL, NULL,
	7, 0, 0);
```

## src/Q_Bluetooth.cpp
```c
/*
 * To change this license header, choose License Headers in Project Properties.
 * To change this template file, choose Tools | Templates
 * and open the template in the editor.
 */



#include "Q_Bluetooth.hpp"
#include "Q_GPIO.hpp"

static uint8_t mfg_data[] = {0xff, 0xff, 0x73};
static uint8_t temp_data[] = {0x09, 0x18, 0x33};
//char macAddress[] = "xx:xx:xx:xx:xx:xx";
uint8_t sidCounter = 0;
char* macAddress;
uint8_t ignoreMac[] = {0xCD, 0xE4, 0xEF, 0x2D, 0x7C, 0x00};
uint8_t QoudraMac1[] = {0x4d, 0xb9, 0x1f, 0x5e, 0x6C, 0xCA};
uint8_t QoudraMac2[] = {0xf5, 0x20, 0x81, 0x1e, 0x05, 0xF9};
uint8_t QoudraMac3[] = {0x15, 0x44, 0x6b, 0x02, 0xd7, 0xF1};
uint8_t QoudraMac4[] = {0x86, 0xE7, 0xAB, 0x61, 0xA9, 0xD4};
uint8_t QoudraMac5[] = {0xb2, 0x6B, 0x6C, 0x62, 0xF5, 0xDF};
uint8_t QoudraMac6[] = {0x37, 0x14, 0x0e, 0x95, 0x96, 0xfb};
uint8_t SkymindPocMac[] = {0x49, 0xf0, 0x9f, 0xb7, 0xac, 0xeb};
const struct bt_data ad[] = {
	BT_DATA_BYTES(BT_DATA_FLAGS, (BT_LE_AD_GENERAL | BT_LE_AD_NO_BREDR)),
	BT_DATA_BYTES(BT_DATA_UUID16_ALL, 0x01, 0x02, 0x03, 0x04, 0x05, 0x06),
};

int bt_ret;



#ifdef BLE4_ADV
static const struct bt_data ad[] = {
	BT_DATA(BT_DATA_MANUFACTURER_DATA, mfg_data, 3),
	BT_DATA(BT_DATA_NAME_COMPLETE, "Qoudra@Skymind.My", 17),
	BT_DATA(BT_DATA_SVC_DATA16, temp_data, 3)
};
#endif
#ifdef BLE5_ADV

struct bt_le_ext_adv *adv;
#endif

#ifdef BLE5_SCANNER 

const struct bt_le_scan_param scan_param = {
	.type = BT_HCI_LE_SCAN_PASSIVE,
	.options = BT_LE_SCAN_OPT_CODED,
	.interval = 0x0010,
	.window = 0x0010,
};
#endif

#ifdef BLE4_SCANNER
struct bt_le_scan_param scan_param = {
	.type = BT_HCI_LE_SCAN_PASSIVE,
	.options = BT_LE_SCAN_OPT_NONE,
	.interval = 0x0010,
	.window = 0x0010,
};
#endif

#if defined BLE4_ADV || defined BLE5_ADV
struct bt_le_adv_param *adv_param =
	BT_LE_ADV_PARAM(BT_LE_ADV_OPT_USE_TX_POWER | BT_LE_ADV_OPT_USE_IDENTITY,
	BT_GAP_ADV_FAST_INT_MIN_2,
	BT_GAP_ADV_FAST_INT_MAX_2,
	NULL);

#endif

void print_macaddress(const bt_addr_le_t* bt_add)
{
	for (int i = 0; i < 6; i++) {
		printq("%X", bt_add->a.val[5 - i]);
		//    macAddress[i * 2 + i ] = temp[0];
		//    if (bt_add->a.val[i] == 0) {
		//      printq("0");
		//    }
		if (i != 5) {
			printq(":");
		}
	}
}

void macaddress_to_string(const bt_addr_le_t * bt_add)
{
	char temp[2];
	for (int i = 0; i < 6; i++) {
		sprintf(temp, "%X", bt_add->a.val[5 - i]);
		macAddress[i * 2 + i ] = temp[0];
		if (bt_add->a.val[i] == 0) {
			macAddress[i * 2 + i + 1] = temp[0];
		} else {
			macAddress[i * 2 + i + 1] = temp[1];
		}
	}
	//  bt_addr_le_to_str(bt_add,macAddress,10);
}

bool isMacEqual(const uint8_t mac1[], const uint8_t mac2[])
{
	if (sizeof(mac2) == 0)return false;
	for (int i = 0; i < 6; i++) {
		if (mac1[i] != mac2[i])
			return false;
	}
	return true;
}

void scan_cb(const bt_addr_le_t *addr, int8_t rssi, uint8_t adv_type,
	struct net_buf_simple * buf)
{
//	if (isMacEqual(QoudraMac1, addr->a.val) || isMacEqual(QoudraMac2, addr->a.val) || isMacEqual(QoudraMac3, addr->a.val) || isMacEqual(QoudraMac4, addr->a.val) || isMacEqual(SkymindPocMac, addr->a.val) || isMacEqual(QoudraMac6, addr->a.val)) {
#ifdef Q_GPIO_INIT
		q_led_1.set_blink(1, 50);
#endif
		printq("{");

		printq("\"macAdress\":");
		printq("\"");
		print_macaddress(addr);
		printq("\",");

		printq("\"rssi\":%d,", rssi);
		printq("\"advType\":%d,", adv_type);
		printq("\"data\":\"");
		for (int i = 0; i < buf->len; i++) {
			printq("0x%X ", buf->data[i]);
		}
		printq("\"");
		printq("};\n");
//	}
}

void ble4_scanner()
{
#ifdef BLE4_SCANNER
	ret = bt_le_scan_start(&scan_param, scan_cb);
	if (bt_ret) {
		printq("Starting scanning failed (ret %d)\n", bt_ret);

		return;
	}
	printq("BLE4 Scanning started!\n");
#endif

}

void start_ble5_scanner()
{
#ifdef BLE5_SCANNER
	bt_ret = bt_le_scan_start(&scan_param, scan_cb);
	if (bt_ret) {
		printq("Starting scanning failed (ret %d)\n", bt_ret);

		return;
	}
	printq("BLE5 Scanning started!\n");
#endif
}

void stop_ble5_scanner()
{
	printq("ble5 scanning stopped\n");
	bt_le_scan_stop();
}

void ble4_adv()
{
#ifdef BLE4_ADV

	ret = bt_le_adv_start(adv_param, ad, ARRAY_SIZE(ad),
		NULL, 0);
	if (bt_ret) {
		printq("Advertising failed to start (ret %d)\n", bt_ret);

		return;
	}
	printq("BLE4 Adv started!\n");
#endif
}

void start_ble5_adv()
{
#ifdef BLE5_ADV
	printq("init BLE5 Adv\n");
	//    adv_param->options = BT_LE_ADV_OPT_CONNECTABLE;

	adv_param->options = BT_LE_ADV_OPT_EXT_ADV;
	adv_param->options |= BT_LE_ADV_OPT_CODED;
	adv_param->options |= BT_LE_ADV_OPT_USE_IDENTITY;
	adv_param->id = BT_ID_DEFAULT;
	adv_param->sid = sidCounter++;
	adv_param->interval_min = BT_GAP_ADV_FAST_INT_MIN_2;
	adv_param->interval_max = BT_GAP_ADV_FAST_INT_MAX_2;
	printq("BLE5 packet created\n");
	bt_le_ext_adv_delete(adv);
	bt_ret = bt_le_ext_adv_create(adv_param, NULL, &adv);
	if (bt_ret) {
		printq("Advertising failed to create (ret %d)\n", bt_ret);
		return;
	}
	printq("BLE5 packet converted\n");

	bt_le_ext_adv_set_data(adv, ad, ARRAY_SIZE(ad), NULL, 0);
	bt_ret = bt_le_ext_adv_start(adv, NULL);
	if (bt_ret) {
		printq("Advertising failed to start (ret %d)\n", bt_ret);

		return;
	}
	printq("BLE5 Adv started!\n");
#endif
}

void stop_ble5_adv()
{
	printq("ble5 adv stopped\n");
	bt_le_ext_adv_stop(adv);
}

void init_bluetooth()
{
#if defined BLE5_ADV || defined BLE4_ADV || defined BLE5_SCANNER || defined BLE4_SCANNER 
	printq("Starting Bluetooth Subsystem\n");
	bt_ret = bt_enable(NULL);
	if (bt_ret) {
		printq("Bluetooth init failed (ret %d)\n", bt_ret);

		return;
	}
	printq("Bluetooth initialized.");
	bt_addr_le_t addr;
	size_t size(6);
	bt_id_get(&addr, &size);
	print_macaddress(&addr);
	printq("\n");

#endif
}
```

## src/Q_Bluetooth.hpp
```c
#ifndef Q_BLUETOOTH_H
#define Q_BLUETOOTH_H
#endif
#ifdef Q_BLUETOOTH_H
#include <bluetooth/bluetooth.h>
#include <bluetooth/hci.h>
#include <bluetooth/addr.h>
#include <bluetooth/gap.h>
#include <cstdio>
#include <stdio.h>
#include <stdlib.h>
#include <sys/printk.h>
//#include "Q_Globals.hpp"
#include "Q_Logger.h"
//#define BLE4_ADV
#define BLE5_ADV
//#define BLE4_SCANNER
#define BLE5_SCANNER
//#define LOG_BT_HEX
//#define BT_SCANNER_LOGGER
static void adv_recv(const struct bt_le_scan_recv_info *info, struct net_buf_simple *buf);

void print_macaddress(const bt_addr_le_t* bt_add);

void macaddress_to_string(const bt_addr_le_t * bt_add);

bool isMacEqual(const uint8_t mac1[], const uint8_t mac2[]);

void scan_cb(const bt_addr_le_t *addr, int8_t rssi, uint8_t adv_type,
	struct net_buf_simple * buf);

void ble4_scanner();

void start_ble5_scanner();
void stop_ble5_scanner();
void ble4_adv();

void start_ble5_adv();
void stop_ble5_adv();
void init_bluetooth();
#endif
```

## src/Q_GPIO.cpp
```c
/*
 * To change this license header, choose License Headers in Project Properties.
 * To change this template file, choose Tools | Templates
 * and open the template in the editor.
 */

/* 
 * File:   Q_GPIO.cpp
 * Author: mdarweash
 * 
 * Created on November 3, 2020, 3:09 PM
 */

#include "Q_GPIO.hpp"

#include "kernel.h"

extern const k_tid_t thread_led_blinker_id;
extern Q_GPIO q_led_0(PIN0, GPIO_OUTPUT_ACTIVE | FLAGS0);
extern Q_GPIO q_led_1(PIN1, GPIO_OUTPUT_LOW);

Q_GPIO::Q_GPIO(uint8_t pin, gpio_flags_t flags)
{
	this->flags = flags;
	this->pin = pin;

}

void Q_GPIO::init(const char * devName)
{
	//		this->dev = dev;
	this->dev = device_get_binding(devName);
	ret = gpio_pin_configure(dev, pin, flags);
	if (ret < 0) {
		printq("failed init PIN %s", devName);
		return;
	}
	printq("init PIN %s OK", devName);
}

void Q_GPIO::setPinActive()
{
	gpio_pin_set(dev, pin, true);
}

void Q_GPIO::setPinInActive()
{
	gpio_pin_set(dev, pin, false);
}

void Q_GPIO::setPin(uint8_t value)
{
	//		this->value = value;
	gpio_pin_set_raw(dev, pin, value);
}

uint8_t Q_GPIO::getPin()
{
	//		value = gpio_pin_get(dev, pin);
	return gpio_pin_get_raw(dev, pin);
}

void Q_GPIO::invert()
{
	gpio_pin_set(dev, pin, value);
	value = !value;
}

void Q_GPIO::set_blink(int blinks, int delay)
{
	this->blinks = blinks;
	this->delay = delay;
//	printq("waking up the thread\n");
	k_wakeup(thread_led_blinker_id);
//	printq("waking up the thread Done\n");
}

void Q_GPIO::blink()
{
	for (int i = 0; i < blinks; i++) {
		setPinActive();
		k_sleep((K_MSEC(delay)));
		setPinInActive();
		k_sleep((K_MSEC(delay)));
	}
	blinks = 0;
	delay = 0;
}

void thread_led_blinker()
{

	printq("thread_led_blinker started\n");

	//	printq("thread_led_blinker:%s\n",leds_thread);
	while (1) {
#ifdef Q_GPIO_INIT
		//		//		pin_1_10.invert();
		//		//		printq("INPUT now :%d\n" + pin_0_10.getPin());
		//		//        printq("inverting a led\n");
		//		q_led_snd_is_on = !q_led_snd_is_on;
		//		q_led_0.invert();
//		printq("ledBlinked| Started\n");
		q_led_0.blink();
		q_led_1.blink();
//		printq("ledBlinked| Sleeping...\n");
		k_sleep(K_FOREVER);
#endif
	}
}
K_THREAD_DEFINE(thread_led_blinker_id, 1024, thread_led_blinker, NULL, NULL, NULL,
	7, 0, 0);
```

## src/Q_GPIO.hpp
```c
/*
 * To change this license header, choose License Headers in Project Properties.
 * To change this template file, choose Tools | Templates
 * and open the template in the editor.
 */

/* 
 * File:   Q_GPIO.hpp
 * Author: mdarweash
 *
 * Created on November 3, 2020, 3:09 PM
 */

#ifndef Q_GPIO_HPP
#define Q_GPIO_HPP
#define Q_GPIO_INIT

#include <zephyr.h>
#include <device.h>
#include <devicetree.h>
#include <drivers/gpio.h>
#include <sys/printk.h>
#include "Q_Logger.h"
#include "Q_Globals.hpp"
#define LED0_NODE DT_ALIAS(led0)
#define LED1_NODE DT_ALIAS(led1)

#if DT_NODE_HAS_STATUS(LED0_NODE, okay)
#define LED0 DT_GPIO_LABEL(LED0_NODE, gpios)
#define PIN0 DT_GPIO_PIN(LED0_NODE, gpios)
#define FLAGS0 DT_GPIO_FLAGS(LED0_NODE, gpios)
#else

/* A build error here means your board isn't set up to blink an LED. */
#error "Unsupported board: led0 devicetree alias is not defined"
#define LED0 ""
#define PIN0 0
#define FLAGS0 0
#endif
#if DT_NODE_HAS_STATUS(LED1_NODE, okay)
#define LED1 DT_GPIO_LABEL(LED1_NODE, gpios)
#define PIN1 DT_GPIO_PIN(LED1_NODE, gpios)
#define FLAGS1 DT_GPIO_FLAGS(LED1_NODE, gpios)
#else
/* A build error here means your board isn't set up to blink an LED. */
#error "Unsupported board: led0 devicetree alias is not defined"
#define LED1 ""
#define PIN1 0
#define FLAGS1 0
#endif

class Q_GPIO {
	int ret;
	static const struct device *gpioDev0;
	static const struct device *gpioDev1;
	int blinks = 0;
	int delay = 0;
public:
	uint8_t pin;
	const struct device *dev;
	uint8_t value = false;
	gpio_flags_t flags;

	Q_GPIO(uint8_t pin, gpio_flags_t flags);

	void init(const char * devName);

	void setPinActive();

	void setPinInActive();

	void setPin(uint8_t value);

	uint8_t getPin();

	void invert();

	void set_blink(int blinks, int delay);

	void blink();
};
extern Q_GPIO q_led_0;
extern Q_GPIO q_led_1;
#endif /* Q_GPIO_HPP */
```

## src/Q_Globals.cpp
```c
/*
 * To change this license header, choose License Headers in Project Properties.
 * To change this template file, choose Tools | Templates
 * and open the template in the editor.
 */

/* 
 * File:   Q_Globals.cpp
 * Author: mdarweash
 * 
 * Created on November 16, 2020, 4:33 PM
 */
bool ready = false;
```

## src/Q_Globals.hpp
```c
/*
 * To change this license header, choose License Headers in Project Properties.
 * To change this template file, choose Tools | Templates
 * and open the template in the editor.
 */

/* 
 * File:   Q_Globals.hpp
 * Author: mdarweash
 *
 * Created on November 16, 2020, 4:35 PM
 */
#ifndef Q_GLOBALS_HPP
#define Q_GLOBALS_HPP
extern bool ready;
#endif /* Q_GLOBALS_HPP */
```

## src/Q_Logger.cpp
```c
/*
 * To change this license header, choose License Headers in Project Properties.
 * To change this template file, choose Tools | Templates
 * and open the template in the editor.
 */

/* 
 * File:   Q_Logger.cpp
 * Author: mdarweash
 * 
 * Created on November 4, 2020, 12:28 PM
 */

#define Q_LOGGER_ON
#include "Q_Logger.h"

void printq(const char *fmt, ...)
{
#ifdef Q_LOGGER_ON
	va_list args;
	va_start(args, NULL);
	vprintk(fmt, args);
	va_end(args);
#endif
}
```

## src/Q_Logger.h
```c
/*
 * To change this license header, choose License Headers in Project Properties.
 * To change this template file, choose Tools | Templates
 * and open the template in the editor.
 */

/* 
 * File:   Q_Logger.h
 * Author: mdarweash
 *
 * Created on November 4, 2020, 12:28 PM
 */

#ifndef Q_LOGGER_H
#define Q_LOGGER_H
#include <zephyr.h>


void printq(const char *fmt, ...);
#endif /* Q_LOGGER_H */
```

## src/Q_Timer.cpp
```c
/*
 * To change this license header, choose License Headers in Project Properties.
 * To change this template file, choose Tools | Templates
 * and open the template in the editor.
 */

/* 
 * File:   Q_Timer.c
 * Author: mdarweash
 * 
 * Created on November 11, 2020, 7:32 PM
 */

#include "Q_Timer.hpp"

#ifdef COUNTER_RTC
#define TIMER DT_LABEL(DT_NODELABEL(timer1))
#define DELAY 10000000
#define ALARM_CHANNEL_ID 0
const struct device *counter_dev;
struct counter_alarm_cfg alarm_cfg;
int timer_ret;
#endif

void test_counter_interrupt_fn(const struct device *counter_dev,
	uint8_t chan_id, uint32_t ticks,
	void *user_data)
{
#ifdef COUNTER_RTC
	printq("alarm!!!!!!!!!!!!!!!!!!!!!!!!!!!");
	k_sleep(K_MSEC(100));
	printq("I'm Ok\n");
	timer_ret = counter_set_channel_alarm(counter_dev, ALARM_CHANNEL_ID,
		&alarm_cfg);
	//	printq("USEC_PER_SEC=%d\n",USEC_PER_SEC);
	printq("Set alarm in %u sec (%u ticks)\n",
		(uint32_t) (counter_ticks_to_us(counter_dev,
		alarm_cfg.ticks) / USEC_PER_SEC),
		alarm_cfg.ticks);

	if (-EINVAL == timer_ret) {
		printq("Alarm settings invalid\n");
	} else if (-ENOTSUP == timer_ret) {
		printq("Alarm setting request not supported\n");
	} else if (timer_ret != 0) {
		printq("Error\n");
	}
	printq("new Alarm set!\n");
#endif
}

void init_times()
{
#ifdef COUNTER_RTC
	printq("Counter alarm sample\n\n");
	counter_dev = device_get_binding(TIMER);
	if (counter_dev == NULL) {
		printq("Device not found\n");
		return;
	}

	timer_ret = counter_start(counter_dev);
	if (timer_ret != 0) {
		printq("timer init problem%d\n", timer_ret);
	}
	alarm_cfg.flags = 0;
	alarm_cfg.ticks = counter_us_to_ticks(counter_dev, DELAY);
	alarm_cfg.callback = test_counter_interrupt_fn;
	alarm_cfg.user_data = &alarm_cfg;

	timer_ret = counter_set_channel_alarm(counter_dev, ALARM_CHANNEL_ID,
		&alarm_cfg);
	printq("Set alarm in %u sec (%u ticks)\n",
		(uint32_t) (counter_ticks_to_us(counter_dev,
		alarm_cfg.ticks) / USEC_PER_SEC),
		alarm_cfg.ticks);

	if (-EINVAL == timer_ret) {
		printq("Alarm settings invalid\n");
	} else if (-ENOTSUP == timer_ret) {
		printq("Alarm setting request not supported\n");
	} else if (timer_ret != 0) {
		printq("Error\n");
	}
#endif
}
```

## src/Q_Timer.hpp
```c
/*
 * To change this license header, choose License Headers in Project Properties.
 * To change this template file, choose Tools | Templates
 * and open the template in the editor.
 */

/* 
 * File:   Q_Timer.h
 * Author: mdarweash
 *
 * Created on November 11, 2020, 7:32 PM
 */
#ifndef Q_TIMER_H
#define Q_TIMER_H

#define COUNTER_RTC

#include <zephyr.h>
#include <device.h>
#include <drivers/counter.h>
#include <sys/printk.h>
#include "Q_Globals.hpp"
#include "Q_Logger.h"
#include <power/power.h>
void init_RTC();
void test_counter_interrupt_fn(const struct device *counter_dev,
	uint8_t chan_id, uint32_t ticks,
	void *user_data);
#endif /* Q_TIMER_H */
```

## src/Q_ULP.cpp
```c
/*
 * To change this license header, choose License Headers in Project Properties.
 * To change this template file, choose Tools | Templates
 * and open the template in the editor.
 */

/* 
 * File:   Q_ULP.cpp
 * Author: mdarweash
 * 
 * Created on November 3, 2020, 2:49 PM
 */

#include "Q_ULP.hpp"

void disable_state()
{
//	sys_pm_ctrl_disable_state(SYS_POWER_STATE_DEEP_SLEEP_1);
}

void set_power_state()
{
//	int rc = device_set_power_state(cons, DEVICE_PM_LOW_POWER_STATE, NULL, NULL);
}
```

## src/Q_ULP.hpp
```c
/*
 * To change this license header, choose License Headers in Project Properties.
 * To change this template file, choose Tools | Templates
 * and open the template in the editor.
 */

/* 
 * File:   Q_ULP.hpp
 * Author: mdarweash
 *
 * Created on November 3, 2020, 2:49 PM
 */

#ifndef Q_ULP_HPP
#define Q_ULP_HPP
#include <stdio.h>
#include <zephyr.h>
#include <device.h>
#include <init.h>
#include <power/power.h>
#include <hal/nrf_gpio.h>
#include <sys/printk.h>

#endif /* Q_ULP_HPP */
```
